## CMakeLists.txt
```
# SPDX-License-Identifier: Apache-2.0

cmake_minimum_required(VERSION 3.13.1)
find_package(Zephyr HINTS $ENV{ZEPHYR_BASE})
project(external_lib)

#target_sources(app PRIVATE src/hello_world_test.cc)
target_sources(app PRIVATE src/main.cc)
target_sources(app PRIVATE src/main_functions.cc)
target_sources(app PRIVATE src/constants.cc)
target_sources(app PRIVATE src/output_handler.cc)
target_sources(app PRIVATE src/model.cc)
target_sources(app PRIVATE src/assert.cc)

zephyr_include_directories(src)

#zephyr_cc_option(-lstdc++)

# The external static library that we are linking with does not know
# how to build for this platform so we export all the flags used in
# this zephyr build to the external build system.
#
# Other external build systems may be self-contained enough that they
# do not need any build information from zephyr. Or they may be
# incompatible with certain zephyr options and need them to be
# filtered out.


list(GET ZEPHYR_RUNNER_ARGS_jlink 1 MCPU_FLAG ) #Here we assume that '-mcpu' will be the second argument. This might be wrong. 
string(REPLACE "=" ";" MCPU_FLAG_LIST ${MCPU_FLAG})
list(GET MCPU_FLAG_LIST 1 MCPU)

set(TARGET ${BOARD})
set(TARGET_ARCH cortex-m4)

set(TF_SRC_DIR /Users/christosprofentzas/EmbeddedML/ncs/tensorflow)
set(TF_MAKE_DIR ${TF_SRC_DIR}/tensorflow/lite/micro/tools/make)
set(TF_LIB_DIR ${TF_MAKE_DIR}/gen/${TARGET}_${TARGET_ARCH}/lib)
set(extra_project_flags "-mcpu=${TARGET_ARCH} -mthumb -mno-thumb-interwork -mfloat-abi=hard -mfpu=fpv4-sp-d16") #I had to remove -DTF_LITE_STATIC_MEMORY to make hello_world run. 

zephyr_get_include_directories_for_lang_as_string(       C C_includes)
zephyr_get_system_include_directories_for_lang_as_string(C C_system_includes)
zephyr_get_compile_definitions_for_lang_as_string(       C C_definitions)
zephyr_get_compile_options_for_lang_as_string(           C C_options)

set(external_project_cflags
  "${C_includes} ${C_definitions} ${optC_optionsions} ${C_system_includes} ${extra_project_flags}"
)

zephyr_get_include_directories_for_lang_as_string(       CXX CXX_includes)
zephyr_get_system_include_directories_for_lang_as_string(CXX CXX_system_includes)
zephyr_get_compile_definitions_for_lang_as_string(       CXX CXX_definitions)
zephyr_get_compile_options_for_lang_as_string(           CXX CXX_options)

set(external_project_cxxflags
  "${CXX_includes} ${CXX_definitions} ${CXX_options} ${CXX_system_includes} ${extra_project_flags}"
)

include(ExternalProject)

# Add an external project to be able download and build the third
# party library. In this case downloading is not necessary as it has
# been committed to the repository.




if(CMAKE_GENERATOR STREQUAL "Unix Makefiles")
# https://www.gnu.org/software/make/manual/html_node/MAKE-Variable.html
set(submake "$(MAKE)")
else() # Obviously no MAKEFLAGS. Let's hope a "make" can be found somewhere.
set(submake "make")
endif()

ExternalProject_Add(
  tf_project                 # Name for custom target
  #PREFIX     ${mylib_build_dir} # Root dir for entire project
  SOURCE_DIR ${TF_SRC_DIR}
  BINARY_DIR ${TF_SRC_DIR} # This particular build system is invoked from the root
  CONFIGURE_COMMAND ""    # Skip configuring the project, e.g. with autoconf
  BUILD_COMMAND
  ${submake} -f tensorflow/lite/micro/tools/make/Makefile
  TARGET=${TARGET}
  TARGET_ARCH=${TARGET_ARCH}
  TARGET_TOOLCHAIN_ROOT=${GNUARMEMB_TOOLCHAIN_PATH}/bin/
  TARGET_TOOLCHAIN_PREFIX=arm-none-eabi-
  #PREFIX=${mylib_build_dir}
  CC=${CMAKE_C_COMPILER}
  CXX=${CMAKE_CXX_COMPILER}
  AR=${CMAKE_AR}
  CCFLAGS=${external_project_cflags} 
  CXXFLAGS=${external_project_cxxflags} 
  microlite 
  INSTALL_COMMAND ""      # This particular build system has no install command
  BUILD_BYPRODUCTS ${TF_LIB_DIR}/libtensorflow-microlite.a
  )

# Create a wrapper CMake library that our app can link with
add_library(tf_lib STATIC IMPORTED GLOBAL)

add_dependencies(
  tf_lib
  tf_project
  )
set_target_properties(tf_lib PROPERTIES IMPORTED_LOCATION             ${TF_LIB_DIR}/libtensorflow-microlite.a)
set_target_properties(tf_lib PROPERTIES INTERFACE_INCLUDE_DIRECTORIES "${TF_SRC_DIR};${TF_SRC_DIR}/tensorflow/lite/micro;${TF_MAKE_DIR}/downloads/flatbuffers/include") 

#zephyr_include_directories(
#  ${GNUARMEMB_TOOLCHAIN_PATH}/arm-none-eabi/include/
#  ${GNUARMEMB_TOOLCHAIN_PATH}/arm-none-eabi/include/c++/9.2.1
#  ${GNUARMEMB_TOOLCHAIN_PATH}/arm-none-eabi/include/c++/9.2.1/arm-none-eabi
#)


target_link_libraries(app PUBLIC tf_lib)
```

## prj.conf
```kconfig
CONFIG_STDOUT_CONSOLE=y
CONFIG_CPLUSPLUS=y
CONFIG_STD_CPP11=y
CONFIG_NEWLIB_LIBC=y
CONFIG_FPU=y
CONFIG_FP_HARDABI=y

# CONFIG_FPU_SHARING=y

# CONFIG_CMSIS_DSP=y
# CONFIG_CMSIS_DSP_AUTOVECTORIZE=y
# CONFIG_CMSIS_DSP_BASICMATH=y
# CONFIG_CMSIS_DSP_COMPLEXMATH=y
# CONFIG_CMSIS_DSP_CONTROLLER=y
# CONFIG_CMSIS_DSP_FILTERING=y
# CONFIG_CMSIS_DSP_MATRIX=y
# CONFIG_CMSIS_DSP_SUPPORT=y
# CONFIG_CMSIS_DSP_DISTANCE=y
# CONFIG_CMSIS_DSP_FASTMATH=y
# CONFIG_CMSIS_DSP_ROUNDING=y
# CONFIG_CMSIS_DSP_STATISTICS=y
# CONFIG_CMSIS_DSP_SUPPORT=y

CONFIG_MPU_ALLOW_FLASH_WRITE=y



CONFIG_LIB_CPLUSPLUS=y

CONFIG_HEAP_MEM_POOL_SIZE=16384
CONFIG_MAIN_STACK_SIZE=8192
CONFIG_SYSTEM_WORKQUEUE_STACK_SIZE=8192

CONFIG_PWM=y


# enabale RTT logging
CONFIG_USE_SEGGER_RTT=y
CONFIG_RTT_CONSOLE=y
CONFIG_LOG_PRINTK=y
CONFIG_LOG=y

# Logging
# CONFIG_USE_SEGGER_RTT=n
# CONFIG_LOG=y
# CONFIG_LOG_DEFAULT_LEVEL=4
# CONFIG_LOG_BACKEND_RTT=n
# CONFIG_LOG_BACKEND_UART=y
# CONFIG_LOG_MODE_NO_OVERFLOW=y
# CONFIG_LOG_BUFFER_SIZE=2048
# CONFIG_LOG_PRINTK=y
CONFIG_LOG_PRINTK_MAX_STRING_LENGTH=256
# CONFIG_SENSOR_LOG_LEVEL_DBG=y
# CONFIG_NEWLIB_LIBC=y
# CONFIG_NEWLIB_LIBC_FLOAT_PRINTF=y
# CONFIG_RTT_CONSOLE=n            # Disable RTT console
CONFIG_UART_CONSOLE=n
```

## src/cifar_input.h
```c
#define IMG_DATA { 154,177,187,126,137,136,105,104, 95,102,101, 99,125,131,139,155,166,180,172,190,210,180,199,214,142,156,156,111,120,110,106,107, 98,109,104,102,123,121,117,127,129,127,181,188,189,217,226,229,209,211,211,166,167,162,164,165,156,158,160,148,116,117,103,102,101, 83, 95, 95, 76, 90, 89, 79, 72, 70, 69, 60, 60, 61, 56, 57, 54, 77, 78, 72, 94, 96, 84, 91, 95, 71, 87, 90, 71, 79, 81, 70,140,160,169,145,153,154,125,125,118,124,129,132,150,161,173,152,164,175,174,188,200,178,189,196,134,139,137,110,111,102,133,127,120,163,156,156,192,192,187,218,219,215,240,241,238,245,246,245,241,242,239,238,239,235,234,235,229,226,227,220,142,143,136, 96, 97, 85, 99,101, 84, 95, 96, 87, 89, 89, 86, 80, 81, 77, 65, 67, 60, 84, 86, 76, 92, 95, 80, 96, 99, 78, 77, 80, 62, 71, 73, 61,140,155,164,139,146,149,115,115,112,147,153,159,138,150,162,132,145,154,170,184,190,178,189,192,171,176,175,192,195,189,219,218,217,234,233,238,229,237,235,239,245,242,244,244,242,246,242,241,232,231,227,225,226,222,235,235,232,243,243,242,177,177,178,101,102, 97,101,103, 92, 88, 89, 82,103,103, 99, 94, 95, 86, 65, 67, 54, 83, 86, 70, 90, 93, 75, 79, 82, 64, 68, 70, 55, 67, 69, 55,136,147,155,137,142,146,122,121,121,132,133,139,151,157,167,181,193,198,203,222,224,208,227,230,208,223,225,203,219,217,179,194,198,169,184,196,164,186,190,125,141,143,178,182,185,240,236,238,231,230,226,211,212,207,195,195,196,201,200,204,183,183,192,121,123,124, 91, 94, 87, 94, 97, 92, 91, 94, 88, 77, 80, 66, 69, 72, 55, 97,100, 80, 88, 91, 70, 76, 78, 64, 64, 66, 53, 71, 73, 59,129,137,144,141,146,152,136,139,142,186,186,190,215,220,227,202,216,223,164,188,195,150,178,185,138,162,169,119,146,150, 94,122,133,108,137,154,108,139,147, 32, 52, 60,130,138,145,241,239,245,236,235,233,235,236,233,211,211,213,195,194,200,133,134,146,125,128,131,102,107,101, 98,104,100, 88, 92, 84, 80, 82, 66, 90, 93, 73, 94, 97, 74, 69, 73, 50, 71, 73, 60, 68, 70, 57, 87, 89, 74,136,144,149,136,149,165,127,148,164,153,172,181,138,160,173,120,141,161, 93,115,138, 98,118,139,103,120,137, 96,116,131, 86,108,125,119,143,158, 97,119,123, 46, 59, 66,117,122,131,203,206,212,228,231,232,233,236,236,236,240,237,237,240,237,165,170,171,126,125,117,124,132,122, 92,102,102, 88, 87, 82, 78, 76, 64, 87, 86, 70, 98, 99, 77, 76, 77, 55, 67, 69, 57, 81, 83, 71, 91, 93, 81,146,154,172,124,138,168, 88,109,139, 85,105,120, 87,110,124, 84,103,119, 75, 90,108, 78, 92,106, 69, 85, 92, 53, 72, 78, 40, 61, 66, 54, 80, 84, 65, 89, 97, 85, 94,105,117,118,125,144,145,148,175,178,181,213,217,219,232,236,234,239,244,238,180,184,178,128,121,102,115,118,104, 83, 92, 95, 74, 71, 69, 71, 68, 56, 86, 85, 69, 86, 85, 64, 90, 90, 69, 83, 85, 72, 77, 79, 67, 81, 83, 71,162,172,192,110,125,154, 63, 77,106, 73, 82, 99, 58, 71, 82, 46, 57, 60, 47, 55, 58, 31, 42, 46, 15, 33, 38, 19, 40, 43, 39, 63, 65, 63, 93, 99, 92,125,146,121,133,149, 88, 86, 92,120,119,119,139,142,145,154,158,162,199,203,203,235,240,237,209,209,199,192,177,151,146,137,121,108,110,112,101, 97, 93, 99, 97, 83, 97, 96, 79, 73, 72, 53, 79, 79, 60, 94, 96, 82, 83, 85, 71, 74, 76, 62,127,137,138, 70, 90,102, 37, 52, 67, 34, 39, 56, 47, 54, 67, 85, 91, 92,129,132,136,104,111,127, 73, 90,116, 94,114,139,125,149,172,138,168,194,115,151,183,120,131,150, 58, 55, 62, 67, 70, 73,108,112,119,177,180,186,188,191,194,233,237,237,208,203,193,149,121, 94,183,160,142,169,164,158,113,110, 96, 89, 87, 69, 84, 82, 65, 65, 63, 47, 56, 55, 40, 88, 91, 76, 81, 84, 69, 63, 66, 51,71, 75, 69, 74, 98,108, 72, 93,112, 81, 87,110,122,129,147,161,167,175,158,159,178,128,134,169, 93,111,149, 98,119,157,128,152,188,133,164,201,104,138,176,119,125,146, 54, 52, 61, 37, 48, 56, 75, 82, 92,192,194,203,226,229,235,232,237,239,199,187,183,109, 66, 46,148,112, 92,192,183,164,158,156,130,104,104, 82, 69, 68, 50, 75, 73, 59, 80, 79, 66, 88, 91, 73, 67, 70, 52, 56, 59, 41,49, 46, 49, 98,122,144,105,129,165,123,132,165,148,158,179,143,151,166,114,115,148,108,113,155, 95,112,146,101,123,155,125,151,181,128,160,192,101,131,167,118,122,144, 66, 67, 81, 35, 55, 70, 77, 88,103,190,193,202,226,229,234,232,235,239,211,195,197,141, 92, 75,156,115, 91,194,183,152,203,200,163,174,172,146, 96, 95, 76, 72, 70, 59,102,101, 92, 99,102, 84, 93, 96, 77, 79, 82, 63,59, 58, 67,103,121,144, 89,113,143,112,131,159,138,154,177,130,143,166,123,132,161,121,130,162,108,122,152,107,127,155,117,146,171,125,160,185,103,132,161,116,124,148, 78, 86,107, 41, 66, 89, 80, 97,120,189,199,205,224,230,224,233,232,235,213,198,201,146,103, 81,165,127, 97,190,176,139,184,173,129,193,183,150,175,169,147,123,122,115,111,113,109,103,106, 88, 92, 93, 75, 95, 95, 79,84, 88,100,104,123,146, 81,105,132, 89,117,147,118,147,179,113,139,172,114,137,171,105,125,159,100,121,154,104,131,162,113,149,178,135,174,199,125,151,169,124,133,152, 72, 81,103, 42, 64, 91, 89,106,129,191,202,205,222,229,220,230,229,232,215,203,204,145,106, 83,153,116, 84,191,174,137,191,175,131,179,162,127,184,172,145,185,179,161,146,144,130,102,102, 85, 80, 79, 64, 86, 84, 72, 83, 89,103, 99,118,142, 71, 92,119, 88,114,141,105,133,161, 99,125,154, 89,111,141, 94,112,141,107,123,148,128,148,172,142,167,189,163,190,208,160,178,184,151,158,165,106,112,129, 65, 78,104, 89,101,119,188,198,199,220,227,221,227,229,230,216,208,207,161,124,100,159,121, 90,188,169,133,203,184,140,197,176,139,181,163,129,180,167,133,194,185,154,162,157,137, 86, 81, 67, 65, 61, 52,83, 85, 97,103,116,136, 86,100,119,117,129,142,157,167,177,169,175,186,172,176,188,161,162,172,153,152,157,162,163,167,201,204,207,230,235,236,232,240,239,220,224,223,180,183,190,145,150,168,159,168,176,206,215,213,224,231,227,225,230,230,215,211,207,169,135,110,165,127, 96,190,168,133,208,186,142,195,176,135,200,183,141,188,173,131,183,169,130,189,178,151,166,158,137, 86, 83, 69,146,142,148,180,184,195,154,157,168,181,183,186,219,220,221,243,241,243,246,240,244,233,227,228,226,222,218,227,224,219,239,235,230,251,247,244,254,253,253,237,238,233,171,172,169,195,194,199,227,232,231,222,230,226,223,231,229,220,228,226,214,214,208,172,140,114,164,127, 95,188,163,129,210,190,144,196,184,136,200,188,143,181,168,126,185,171,131,186,172,135,187,178,147,146,144,122,197,188,188,240,237,242,231,228,230,242,243,244,240,243,244,242,244,245,248,247,250,251,251,252,250,253,252,252,253,252,250,251,250,247,246,246,251,248,248,230,231,224,206,208,199,215,214,210,218,221,216,217,223,220,217,224,224,216,225,223,212,213,207,169,141,115,162,125, 94,182,154,120,207,188,140,198,188,137,202,188,145,168,149,116,137,116, 87,196,176,136,186,173,134,156,152,123,206,199,199,252,245,249,251,247,246,251,251,249,249,250,249,250,251,250,252,252,251,250,251,250,248,248,248,248,247,247,249,249,249,243,246,244,249,249,246,229,232,226,218,224,217,214,221,215,215,219,219,215,219,221,214,219,221,216,221,222,212,210,208,166,145,120,161,125, 93,182,150,114,208,186,137,205,184,140,210,181,147,179,141,119,136, 93, 78,175,142,113,203,181,141,166,154,122,219,214,217,251,248,254,241,241,243,240,240,239,233,233,233,222,221,222,216,216,216,209,209,211,205,205,209,200,200,204,195,195,198,185,185,188,175,174,175,171,172,173,184,190,188,197,205,204,213,218,224,221,224,230,218,222,224,218,223,220,214,210,204,179,158,128,160,123, 87,174,141,102,206,184,131,206,184,137,208,178,140,193,154,126,167,123,101,166,132,102,202,179,137,181,167,133,139,136,144,136,141,156,119,124,133,107,109,113,109,108,113,102,101,107, 79, 78, 84, 76, 76, 83, 94, 97,105,111,117,124,118,120,128,107,102,112, 69, 65, 71, 55, 53, 59, 84, 86, 90, 87, 91, 95,101,104,114,134,137,144,162,166,168,195,200,195,213,207,196,192,166,133,177,138,101,177,144,105,201,181,127,204,185,133,209,185,138,216,186,146,201,168,133,196,167,130,205,185,137,199,185,147,70, 71, 86, 86, 99,125, 85, 96,113, 36, 38, 48, 67, 66, 76, 87, 85, 95, 52, 50, 60, 48, 48, 57, 86, 94, 99,105,119,122, 88, 92, 99,155,146,156,155,148,155,145,141,147,147,146,151,114,116,120, 76, 79, 85, 56, 60, 65, 72, 75, 77,155,159,158,214,202,196,198,165,135,205,163,130,199,166,133,202,183,134,202,184,133,204,184,135,211,189,143,208,184,141,210,186,143,208,189,137,204,189,147,155,160,180,162,182,217,152,169,193, 48, 51, 66, 92, 90,105, 94, 92,107, 61, 58, 74, 55, 56, 65,124,138,136,141,163,158,131,139,139,231,219,224,241,232,233,230,225,225,228,226,225,224,225,223,216,221,215,194,199,197,163,166,171,173,176,185,190,174,177,158,122, 98,160,114, 90,126, 90, 68,180,160,120,211,192,146,206,189,142,213,197,149,211,194,146,212,192,142,210,193,134,210,194,145,162,166,182,124,142,173,110,127,149, 47, 50, 65, 87, 84, 99, 75, 72, 88, 62, 59, 75, 63, 63, 70,119,128,123,126,142,135,103,109,106,158,148,151,141,135,138,126,123,123,139,137,137,154,154,155,165,168,162,137,140,136,159,160,163,181,180,193,129,105,112,111, 68, 52,108, 62, 47, 72, 38, 24, 98, 79, 55,135,120, 92,150,134,102,165,151,117,174,161,125,189,172,130,194,180,133,204,190,152,149,147,158, 58, 63, 83, 29, 39, 55, 31, 34, 46, 41, 38, 51, 41, 39, 52, 37, 35, 48, 37, 36, 46, 50, 52, 57, 56, 57, 64,104,106,114,152,154,164,127,128,141, 92, 93,101, 73, 74, 82, 67, 66, 80, 41, 42, 48,  8, 10,  7, 60, 59, 58,170,166,172, 75, 49, 55, 71, 34, 33, 57, 27, 26, 48, 27, 23, 38, 27, 26, 37, 28, 30, 48, 32, 25, 53, 38, 28, 56, 45, 35, 69, 56, 40, 97, 87, 72,176,170,160,174,170,183, 95, 95,116, 57, 63, 81, 61, 65, 79, 64, 66, 80, 66, 69, 82, 65, 67, 81, 71, 75, 92, 71, 80,100, 97,106,127,168,177,198,181,187,208,167,162,181, 85, 84, 94, 35, 38, 47, 59, 65, 79, 33, 41, 50, 11, 19, 17, 16, 21, 18,128,128,134, 85, 81, 96, 59, 55, 72, 74, 71, 89, 79, 77, 95, 89, 89,104, 71, 65, 73, 52, 38, 37, 32, 18, 14, 24, 15, 13, 19, 13, 14, 44, 40, 44,155,154,161,156,149,165,151,150,174,153,158,179,160,165,182,164,168,184,166,170,186,164,169,184,167,169,187,162,163,184,153,157,174,149,149,165,150,141,160,132,121,142, 51, 48, 59,  9, 16, 23, 47, 60, 73, 33, 48, 58, 12, 25, 27, 10, 21, 20, 59, 65, 74, 90,100,119, 88, 99,123, 96,101,127,106,106,134, 99, 98,121, 55, 51, 61, 64, 51, 51, 49, 37, 33, 25, 20, 21, 39, 40, 53, 34, 35, 51, 89, 91,107,167,159,172,148,145,166,102,104,123,124,126,140,147,148,160,142,143,155,125,126,139,125,118,131,129,116,126,156,149,152,182,166,165,155,128,135,121,109,128, 73, 71, 83, 61, 67, 75, 64, 75, 89, 37, 51, 65, 37, 50, 57, 13, 24, 29, 39, 46, 59, 84, 91,108, 85, 90,107, 84, 83,102, 96, 87,109, 91, 85,106, 62, 60, 72, 71, 61, 62, 43, 32, 30, 25, 22, 26, 62, 67, 85, 56, 60, 79, 88, 90,107,174,164,170,141,137,150, 44, 46, 56, 43, 41, 48, 57, 51, 57, 52, 46, 53, 44, 37, 44, 48, 37, 46, 79, 69, 75,173,172,168,217,202,194,166,137,137, 97, 92,108, 79, 80, 90, 96, 99,107, 75, 78, 95, 82, 90,109,125,135,148, 37, 43, 54, 43, 46, 65, 79, 80,100, 73, 74, 92, 72, 70, 89, 84, 78, 98, 87, 85,105, 94, 93,106, 72, 64, 67, 43, 34, 33, 34, 33, 37,103,108,123, 95, 98,111,124,123,133,164,155,160,141,139,152,115,119,132,113,113,121,116,108,117,114,105,115,113,108,118,116,112,124,124,123,134,149,156,159,160,156,156,142,128,133, 98,100,116, 40, 44, 56, 21, 23, 35, 55, 56, 74,108,114,132,119,126,140, 46, 49, 61, 45, 44, 60, 69, 71, 92, 71, 74, 96, 69, 71, 92, 75, 76, 96, 79, 82,101,118,121,135, 86, 81, 87, 85, 78, 78, 31, 27, 29, 77, 77, 84, 68, 66, 73, 94, 88, 94,175,167,166,156,154,160,154,160,170,147,153,163,155,153,165,161,154,171,160,163,180,167,173,186,165,165,174,152,152,160,163,162,170,164,163,172,133,138,152, 61, 67, 81, 40, 45, 59, 60, 66, 81, 81, 89,102,100,109,119, 65, 69, 78, 59, 60, 67, 62, 64, 77, 51, 53, 69, 44, 43, 57, 39, 36, 47, 43, 44, 57,102,108,122, 55, 56, 64, 32, 26, 29, 23, 14, 14, 42, 34, 36, 61, 53, 57, 93, 83, 91,165,154,128,156,152,130,159,161,142,131,130,127, 94, 88, 95,102, 92,104,108,107,120,128,129,137,154,149,152,156,151,154,182,177,179,179,175,179,125,129,135, 83, 89, 95, 88, 93, 99, 63, 69, 75, 43, 51, 61, 75, 83, 94, 58, 62, 71, 45, 47, 52, 35, 37, 44, 21, 22, 30, 14, 12, 18, 11,  6,  9, 14, 13, 20, 59, 64, 77, 49, 49, 58, 54, 48, 52, 81, 72, 73,103, 93, 96,123,114,120,131,121,131,163,148,120,158,148,122,163,156,133,145,135,125, 43, 32, 32, 19,  9, 12, 20, 14, 19, 74, 68, 70,134,125,122,119,110,107,110,101, 99, 99, 93, 91, 61, 63, 62, 27, 31, 30, 18, 21, 20, 17, 20, 21, 25, 34, 42, 29, 37, 48, 16, 20, 28,  5,  6, 11,  6,  6, 11, 10,  9, 12, 25, 22, 22, 51, 45, 42, 68, 64, 67, 90, 90,101,116,113,122,134,127,133,140,130,136,143,133,139,143,134,142,143,133,144,}




// {158,112,49,159,111,47,165,116,51,166,118,53,160,112,46,156,109,41,162,115,47,159,113,45,158,111,44,159,113,41,161,116,41,160,111,52,161,111,49,166,117,41,169,117,45,170,119,44,167,117,40,162,113,38,160,111,39,160,112,43,156,109,44,149,107,45,150,107,45,148,106,43,149,107,44,143,101,39,140,98,43,141,97,41,143,97,38,137,95,36,126,91,36,116,85,33,152,112,51,151,110,40,159,114,45,166,116,56,162,112,49,160,113,43,164,117,47,162,114,45,163,116,46,156,110,38,155,111,41,159,110,54,163,113,52,170,119,41,171,117,40,171,115,33,169,115,30,160,111,33,154,112,41,151,115,50,145,110,53,139,104,55,140,102,52,141,100,48,149,105,50,147,102,46,145,102,45,142,97,38,143,98,34,136,95,31,125,91,32,119,88,34,151,110,47,151,109,33,158,111,36,167,111,48,160,106,42,163,115,44,165,117,45,165,117,45,163,115,43,162,115,43,158,114,48,157,109,57,161,111,51,166,115,38,167,114,37,169,113,35,170,116,39,159,114,47,145,111,54,121,96,49,110,90,52,98,78,50,101,77,47,114,85,50,120,86,48,134,96,55,143,103,51,140,99,39,142,99,35,139,98,34,130,95,34,120,89,33,155,107,40,155,110,32,160,109,31,174,112,44,167,110,43,167,117,46,169,120,48,169,119,48,165,115,44,165,117,45,167,123,57,191,146,95,177,130,75,157,111,41,162,115,47,164,114,54,158,112,58,149,111,67,104,80,47,103,87,65,98,90,76,92,90,84,80,75,66,74,63,50,86,70,52,83,62,39,113,85,45,132,98,46,140,102,43,140,101,39,136,99,39,127,94,36,155,107,41,156,114,48,161,115,49,170,114,47,169,114,43,163,113,40,169,120,47,166,116,44,164,113,41,164,116,42,173,128,59,246,214,164,195,156,107,151,114,56,146,111,60,142,108,71,111,80,50,78,53,31,85,69,56,113,103,98,112,110,111,106,114,118,97,102,105,93,94,93,74,72,67,84,78,70,85,73,47,105,83,45,128,96,48,138,101,46,133,94,36,129,93,36,148,109,54,133,104,64,130,100,57,147,112,53,161,115,44,165,113,39,167,116,41,167,115,41,163,111,37,165,116,39,163,118,42,180,138,85,157,122,78,128,102,58,97,75,43,66,50,31,69,58,43,66,56,45,89,83,76,118,113,110,122,121,120,119,122,122,114,116,116,94,96,96,99,100,97,91,91,86,58,58,47,67,58,37,108,84,49,140,105,58,138,98,44,134,95,40,127,100,57,109,95,80,47,37,17,88,74,28,153,117,48,170,118,43,168,115,40,170,118,43,169,117,42,166,116,37,164,120,39,147,107,52,129,98,59,127,108,75,100,87,70,68,67,57,78,83,72,72,75,64,83,84,74,132,130,121,146,142,132,124,118,108,105,99,90,107,102,94,115,111,103,85,83,77,63,71,69,46,47,39,79,61,36,132,98,58,141,99,48,134,93,39,131,115,90,99,96,92,42,43,38,70,64,41,143,111,56,167,117,42,165,114,36,168,116,39,171,119,49,161,113,51,140,109,51,120,94,49,130,110,77,144,131,107,116,106,93,88,87,79,91,95,88,85,88,82,77,77,69,124,118,107,163,153,140,136,124,112,102,93,81,106,98,88,100,93,84,85,81,74,54,60,58,49,53,49,57,47,32,107,83,50,138,103,51,136,97,39,170,161,144,103,105,105,54,58,59,124,121,113,153,124,82,161,113,43,163,117,41,166,122,50,165,121,66,174,135,95,113,89,59,125,105,78,157,141,121,156,143,128,121,111,101,86,80,74,82,81,77,84,85,82,80,78,73,81,71,61,138,125,112,146,135,123,113,103,93,87,79,70,83,77,69,86,82,76,71,73,67,56,57,53,40,35,27,74,59,35,133,106,59,137,103,45,180,176,163,134,139,143,94,100,105,154,154,149,174,149,112,158,116,51,156,116,47,153,118,60,207,180,146,237,214,198,207,180,166,156,131,119,174,153,145,148,131,125,125,110,107,93,85,79,86,84,79,74,74,71,59,57,53,76,68,58,137,125,112,143,133,122,133,124,114,106,98,89,86,81,74,87,85,78,84,85,78,75,76,71,50,49,43,40,30,15,95,75,44,132,103,57,183,183,175,108,116,122,142,151,158,165,169,168,177,156,122,155,112,50,159,118,51,122,89,47,213,197,179,237,224,226,220,191,188,164,135,131,183,159,155,156,137,132,125,108,104,120,111,104,78,76,69,80,80,77,45,44,40,91,85,77,175,165,154,157,147,137,155,147,138,107,100,92,87,83,77,103,102,96,88,88,79,78,79,73,59,59,59,41,36,33,59,46,31,104,81,46,188,191,189,100,108,116,135,144,153,170,175,178,187,167,136,166,120,59,173,123,55,134,93,44,117,95,80,194,182,188,199,171,164,170,142,133,185,161,151,189,171,159,134,119,106,117,107,95,102,98,89,84,84,79,38,38,34,125,121,113,210,201,192,160,152,142,146,139,130,93,89,82,83,80,75,94,93,88,104,104,94,85,87,81,73,75,78,55,53,55,62,55,48,76,56,26,189,194,194,90,96,105,127,134,144,175,180,185,174,156,133,166,123,68,178,123,53,159,109,47,97,68,44,168,154,152,168,144,126,137,114,94,186,166,148,216,202,183,160,149,129,123,113,98,120,114,105,115,114,109,50,50,47,150,147,140,194,187,178,155,149,140,123,118,111,91,88,83,84,83,79,84,84,80,95,95,85,86,87,81,84,87,89,73,73,73,79,74,64,73,55,24,189,192,193,93,95,103,152,154,163,185,188,192,119,110,98,136,106,66,173,124,58,167,116,50,103,72,39,147,132,120,145,125,103,167,149,127,189,174,155,226,216,200,180,172,157,141,131,117,126,117,107,117,114,109,71,71,68,154,152,147,186,181,174,149,144,136,114,110,104,87,85,80,80,80,76,72,73,70,80,80,72,99,100,94,100,101,99,90,88,81,97,89,69,94,73,34,194,196,196,108,107,112,168,167,172,186,186,188,105,109,109,99,89,67,156,119,62,167,122,55,100,74,34,115,106,88,138,123,103,198,185,169,190,180,169,172,165,159,145,140,140,154,143,134,146,136,125,103,100,95,71,71,70,152,152,149,179,175,170,137,133,127,130,128,122,110,109,105,85,86,83,91,93,91,95,96,90,109,110,104,115,116,111,100,96,80,97,85,53,117,95,47,197,197,197,132,129,136,172,167,174,184,178,181,130,137,142,78,83,77,140,120,88,155,125,77,115,94,52,130,120,93,143,131,116,230,221,211,242,236,230,145,138,137,135,130,130,131,121,112,121,112,101,108,104,95,95,88,75,144,134,118,168,159,146,152,147,138,112,108,101,87,85,80,71,72,68,87,88,87,105,104,99,112,109,99,120,110,93,103,86,54,121,96,48,136,104,48,203,203,204,146,146,160,168,164,178,191,182,188,168,170,172,78,86,90,126,125,126,138,126,113,138,121,82,96,80,37,154,143,133,173,163,155,162,152,141,140,132,117,113,106,88,113,106,90,101,101,92,105,101,87,112,90,58,171,143,104,156,138,109,148,141,126,135,130,118,109,105,97,78,76,72,79,79,77,94,93,94,101,91,82,107,83,55,125,88,45,151,108,55,144,104,46,214,215,215,163,166,180,164,167,184,183,184,194,176,182,186,94,102,105,96,96,102,156,149,145,148,137,111,106,93,61,129,116,105,118,105,95,114,102,89,116,105,89,102,91,73,115,110,98,86,91,88,101,103,95,144,128,102,118,96,64,68,56,32,128,120,105,133,126,115,75,69,61,60,56,51,58,56,53,71,70,65,102,93,78,116,94,64,143,112,68,150,116,64,140,110,54,212,211,205,178,184,192,167,175,189,173,181,193,176,184,188,124,131,133,86,88,96,141,139,143,153,148,141,135,128,111,104,90,80,77,64,55,134,121,108,124,111,96,129,117,100,147,143,133,85,92,93,92,96,93,150,139,120,132,117,93,117,109,92,107,99,86,75,68,58,64,59,52,44,41,39,65,62,60,86,69,40,133,105,59,155,119,62,160,120,54,154,115,45,151,111,46,199,192,180,187,189,187,171,176,181,174,179,185,177,182,184,144,149,152,86,90,99,119,121,132,122,124,130,137,136,135,144,134,126,70,59,51,129,118,108,108,97,86,145,134,123,184,176,168,116,118,118,73,75,73,131,119,103,137,124,105,134,129,118,89,86,78,51,49,44,52,51,50,47,49,52,90,90,93,121,91,60,163,118,68,171,121,64,164,113,52,158,111,50,149,107,46,165,156,146,195,193,187,179,178,175,177,173,172,181,181,180,152,157,160,99,103,111,131,135,146,171,175,185,103,105,111,93,90,87,80,77,73,93,90,86,122,118,116,178,173,173,191,182,177,150,148,148,100,100,101,89,78,66,87,77,63,60,61,57,46,52,54,38,46,51,24,33,41,46,57,69,60,71,83,108,100,75,144,125,82,144,123,76,128,109,61,127,113,69,120,105,63,117,120,124,195,200,200,177,178,176,178,169,168,181,179,179,138,144,147,83,87,91,150,153,159,245,247,250,219,222,225,133,140,144,134,141,147,149,156,164,176,182,192,190,196,208,194,192,197,168,172,181,125,133,143,110,109,109,61,62,62,35,49,58,34,54,68,49,70,87,58,81,102,61,85,110,58,84,111,69,99,122,72,101,119,78,104,120,69,96,112,59,92,112,55,90,115,79,105,133,175,197,213,174,183,192,176,172,177,177,177,182,140,146,150,109,112,113,211,211,209,253,252,247,252,253,252,208,224,232,124,143,157,114,132,149,124,141,162,116,133,156,122,133,152,104,124,148,68,93,119,68,87,104,60,82,101,52,84,111,50,84,110,51,85,115,56,93,125,56,94,131,51,91,130,43,96,135,51,104,141,59,108,142,48,97,132,43,97,137,42,95,132,41,89,135,96,137,168,144,168,188,168,174,188,178,182,192,165,170,174,165,166,164,246,245,237,253,251,241,227,231,228,110,136,153,60,88,111,53,80,105,49,76,105,49,75,107,48,72,101,45,79,115,42,81,120,46,81,113,42,82,116,38,86,125,46,90,125,46,89,126,43,87,128,42,89,132,46,93,139,46,94,137,50,96,137,55,96,135,53,94,134,51,95,139,45,90,133,29,91,141,29,87,130,59,102,134,131,153,176,166,179,191,132,136,137,194,189,181,254,250,242,241,245,245,141,159,175,61,94,127,50,84,118,50,84,119,51,85,121,49,83,120,50,84,116,47,86,117,42,84,117,39,82,115,34,79,113,35,83,120,39,86,125,38,85,125,42,89,130,45,92,134,56,103,145,62,103,142,59,101,142,56,102,146,50,99,144,46,94,140,51,103,149,48,111,162,30,94,140,34,85,124,73,106,136,128,148,167,128,136,143,215,213,209,255,253,249,187,198,205,66,93,118,54,91,128,50,88,125,52,90,127,52,90,127,46,83,121,45,82,115,43,82,113,41,81,112,36,80,113,39,83,117,40,86,123,40,89,131,43,92,134,46,95,138,59,108,150,62,110,152,64,109,147,59,108,149,54,108,154,50,105,152,70,123,167,83,137,182,52,114,165,35,99,147,31,86,130,41,83,122,66,95,126,128,145,164,224,229,234,240,245,247,124,143,153,58,92,114,49,87,123,56,94,131,54,92,129,44,82,119,44,82,119,47,83,119,46,84,119,43,83,119,43,86,123,44,88,127,44,90,131,45,97,141,54,106,150,58,110,154,54,105,150,46,97,141,43,95,140,36,91,138,51,108,158,73,130,178,85,138,182,76,125,169,50,110,162,35,98,149,29,89,138,35,86,133,44,83,126,78,106,138,202,219,233,211,228,234,97,126,140,65,104,126,54,94,129,48,87,124,58,97,133,48,87,123,40,80,116,45,82,119,47,84,122,48,87,126,47,89,130,46,89,132,51,97,140,39,92,138,39,93,139,48,102,148,47,101,147,39,93,139,28,85,133,40,101,153,67,129,182,67,126,176,46,98,142,51,96,139,50,108,161,35,97,147,32,92,143,33,88,141,41,88,138,46,84,125,104,133,159,170,197,211,64,100,119,54,97,121,52,94,128,53,95,130,61,103,139,58,100,135,54,96,131,45,83,120,42,79,118,41,80,120,46,88,130,49,92,135,46,92,136,42,95,139,40,93,138,39,92,136,37,90,135,40,93,138,44,102,151,63,125,178,47,110,164,31,90,140,15,60,103,51,93,136,68,124,177,42,100,148,31,88,137,38,91,146,37,87,139,43,89,132,42,79,113,71,107,133,49,89,114,31,77,105,27,71,105,38,82,117,49,93,128,56,100,135,58,102,137,53,92,128,56,94,131,60,99,137,57,99,139,53,97,138,50,95,137,45,94,136,39,88,131,33,83,125,42,91,133,62,112,154,79,132,179,73,131,181,56,116,168,38,97,146,13,64,108,40,85,127,61,116,168,49,102,148,35,85,132,43,91,143,39,90,139,42,92,134,44,88,125,40,81,112,42,85,115,27,72,104,23,67,102,30,74,109,27,71,106,29,73,108,36,80,115,47,86,120,56,95,128,62,101,135,66,109,144,75,119,156,69,113,152,49,95,134,43,88,127,43,88,127,60,105,144,85,130,170,109,156,197,93,145,190,60,115,164,26,82,130,29,82,126,20,64,107,54,107,160,56,105,149,45,89,132,43,86,134,40,89,134,40,92,132,40,87,123,38,81,115,36,79,114,26,69,105,22,66,101,29,73,108,25,69,104,29,73,108,19,63,98,18,58,89,32,70,100,47,87,118,61,104,137,74,119,152,66,111,145,53,96,131,52,95,130,45,87,123,67,109,145,89,131,167,105,146,182,89,135,175,48,99,145,24,77,124,34,84,129,21,67,110}
```

## src/constants.cc
```c
/* Copyright 2019 The TensorFlow Authors. All Rights Reserved.

Licensed under the Apache License, Version 2.0 (the "License");
you may not use this file except in compliance with the License.
You may obtain a copy of the License at

    http://www.apache.org/licenses/LICENSE-2.0

Unless required by applicable law or agreed to in writing, software
distributed under the License is distributed on an "AS IS" BASIS,
WITHOUT WARRANTIES OR CONDITIONS OF ANY KIND, either express or implied.
See the License for the specific language governing permissions and
limitations under the License.
==============================================================================*/

#include "constants.h"

const int kInferencesPerCycle = 10;
```

## src/constants.h
```c
/* Copyright 2019 The TensorFlow Authors. All Rights Reserved.

Licensed under the Apache License, Version 2.0 (the "License");
you may not use this file except in compliance with the License.
You may obtain a copy of the License at

    http://www.apache.org/licenses/LICENSE-2.0

Unless required by applicable law or agreed to in writing, software
distributed under the License is distributed on an "AS IS" BASIS,
WITHOUT WARRANTIES OR CONDITIONS OF ANY KIND, either express or implied.
See the License for the specific language governing permissions and
limitations under the License.
==============================================================================*/

#ifndef TENSORFLOW_LITE_MICRO_EXAMPLES_HELLO_WORLD_CONSTANTS_H_
#define TENSORFLOW_LITE_MICRO_EXAMPLES_HELLO_WORLD_CONSTANTS_H_

// This constant represents the range of x values our model was trained on,
// which is from 0 to (2 * Pi). We approximate Pi to avoid requiring additional
// libraries.
// const float kXrange = 2.f * 3.14159265359f;

// This constant determines the number of inferences to perform across the range
// of x values defined above. Since each inference takes time, the higher this
// number, the more time it will take to run through the entire range. The value
// of this constant can be tuned so that one full cycle takes a desired amount
// of time. Since different devices take different amounts of time to perform
// inference, this value should be defined per-device.
extern const int kInferencesPerCycle;

#endif  // TENSORFLOW_LITE_MICRO_EXAMPLES_HELLO_WORLD_CONSTANTS_H_
```

## src/main_functions.cc
```c
/* Copyright 2020 The TensorFlow Authors. All Rights Reserved.

Licensed under the Apache License, Version 2.0 (the "License");
you may not use this file except in compliance with the License.
You may obtain a copy of the License at

    http://www.apache.org/licenses/LICENSE-2.0

Unless required by applicable law or agreed to in writing, software
distributed under the License is distributed on an "AS IS" BASIS,
WITHOUT WARRANTIES OR CONDITIONS OF ANY KIND, either express or implied.
See the License for the specific language governing permissions and
limitations under the License.
==============================================================================*/

#include "main_functions.h"

#include "tensorflow/lite/micro/all_ops_resolver.h"
#include "constants.h"
#include "model.h"
#include "output_handler.h"
#include "tensorflow/lite/micro/micro_error_reporter.h"
#include "tensorflow/lite/micro/micro_interpreter.h"
#include "tensorflow/lite/schema/schema_generated.h"
#include "tensorflow/lite/version.h"

#include "cifar_input.h"

#include <zephyr.h>

// Globals, used for compatibility with Arduino-style sketches.
namespace
{
tflite::ErrorReporter *error_reporter = nullptr;
const tflite::Model *model = nullptr;
tflite::MicroInterpreter *interpreter = nullptr;
TfLiteTensor *input = nullptr;
TfLiteTensor *output = nullptr;
int inference_count = 0;

float  image_data[3072] = IMG_DATA;


extern "C" const int cifar10_tflite_len;

// Create an area of memory to use for input, output, and intermediate arrays.
// Minimum arena size, at the time of writing. After allocating tensors
// you can retrieve this value by invoking interpreter.arena_used_bytes().
const int kModelArenaSize = 2512;
// Extra headroom for model + alignment + future interpreter changes.
const int kExtraArenaSize =   model_len + 16 + 10600 ;
const int kTensorArenaSize =  kModelArenaSize + kExtraArenaSize;

alignas(16) static uint8_t tensor_arena[kTensorArenaSize];
} // namespace

// The name of this function is important for Arduino compatibility.
void setup()
{
	outputInit();


	// Set up logging. Google style is to avoid globals or statics because of
	// lifetime uncertainty, but since this has a trivial destructor it's okay.
	// NOLINTNEXTLINE(runtime-global-variables)

	static tflite::MicroErrorReporter micro_error_reporter;
	error_reporter = &micro_error_reporter;

	// Map the model into a usable data structure. This doesn't involve any
	// copying or parsing, it's a very lightweight operation.
	model = tflite::GetModel(model_tflite);

	if (model->version() != TFLITE_SCHEMA_VERSION) {
		TF_LITE_REPORT_ERROR(
			error_reporter,
			"Model provided is schema version %d not equal "
			"to supported version %d.",
			model->version(), TFLITE_SCHEMA_VERSION);
	}

	// This pulls in all the operation implementations we need.
	// NOLINTNEXTLINE(runtime-global-variables)
	static tflite::AllOpsResolver resolver;

	// Build an interpreter to run the model with.
	static tflite::MicroInterpreter static_interpreter(model, resolver,
							   tensor_arena,
							   kTensorArenaSize,
							   error_reporter);
	interpreter = &static_interpreter;

	// Allocate memory from the tensor_arena for the model's tensors.
	TfLiteStatus allocate_status = interpreter->AllocateTensors();

	if (allocate_status != kTfLiteOk) {
		TF_LITE_REPORT_ERROR(error_reporter,
				     "AllocateTensors() failed");
	}
	TF_LITE_REPORT_ERROR(error_reporter,"size : %d",interpreter->arena_used_bytes());

	// Obtain pointers to the model's input and output tensors.
	input = interpreter->input(0);
	output = interpreter->output(0);



	// Keep track of how many inferences we have performed.
	inference_count = 0;
}

// The name of this function is important for Arduino compatibility.
void loop()
{

		k_sleep(K_SECONDS(0.1)); 
			//****** DEFINE TIMESTAMPS ******
		s64_t time_stamp;
		s64_t milliseconds_spent;

		/********** capture initial time stamp ********/
		time_stamp = k_uptime_get();

		for (int d = 0; d < 3072; ++d) {input->data.f[d] = image_data[d]/255;}
		
		TfLiteStatus invoke_status = interpreter->Invoke();

		if (invoke_status != kTfLiteOk) {
			TF_LITE_REPORT_ERROR(error_reporter,
						"Invoke failed.");
		}

		float max_score = output->data.f[0];
		float guess = 0;

		for (int category_index = 1; category_index < 10;category_index++) 
		{
			float category_score = output->data.f[category_index];
			if (category_score > max_score) {
				max_score = category_score;
				guess = category_index;
			}
		}
		

		// Output the results. A custom HandleOutput function can be implemented
		// for each supported hardware target.
		int test_y = 9;
		HandleOutput(error_reporter, guess,test_y);


		// ************ GET TIMESTAMP***********
		milliseconds_spent = k_uptime_delta(&time_stamp);
		TF_LITE_REPORT_ERROR( error_reporter, "Time exec = %d",milliseconds_spent);


}
  
```

## src/model.h
```c
/* Copyright 2020 The TensorFlow Authors. All Rights Reserved.

Licensed under the Apache License, Version 2.0 (the "License");
you may not use this file except in compliance with the License.
You may obtain a copy of the License at

    http://www.apache.org/licenses/LICENSE-2.0

Unless required by applicable law or agreed to in writing, software
distributed under the License is distributed on an "AS IS" BASIS,
WITHOUT WARRANTIES OR CONDITIONS OF ANY KIND, either express or implied.
See the License for the specific language governing permissions and
limitations under the License.
==============================================================================*/

// Automatically created from a TensorFlow Lite flatbuffer using the command:
// xxd -i model.tflite > model.cc

// This is a standard TensorFlow Lite model file that has been converted into a
// C data array, so it can be easily compiled into a binary for devices that
// don't have a file system.

// See train/README.md for a full description of the creation process.

#ifndef MODEL_H_
#define MODEL_H_

extern const unsigned char model_tflite[];
const int model_len = 27792;

















#endif  
```

## src/output_handler.cc
```c
/* Copyright 2019 The TensorFlow Authors. All Rights Reserved.

Licensed under the Apache License, Version 2.0 (the "License");
you may not use this file except in compliance with the License.
You may obtain a copy of the License at

    http://www.apache.org/licenses/LICENSE-2.0

Unless required by applicable law or agreed to in writing, software
distributed under the License is distributed on an "AS IS" BASIS,
WITHOUT WARRANTIES OR CONDITIONS OF ANY KIND, either express or implied.
See the License for the specific language governing permissions and
limitations under the License.
==============================================================================*/

#include "output_handler.h"

#include <zephyr.h>
#include <sys/printk.h>
#include <device.h>
#include <devicetree.h>
#include <drivers/gpio.h>
#include <drivers/pwm.h>

#include <sys/__assert.h>

#define LED0_NODE DT_ALIAS(led0)
#define LED1_NODE DT_ALIAS(led1)

#define PWM_LED0_NODE	DT_ALIAS(pwm_led0)
#define FLAGS_OR_ZERO(node)                                                    \
	COND_CODE_1(DT_PHA_HAS_CELL(node, pwms, flags), (DT_PWMS_FLAGS(node)), \
		    (0))

#define PWM_LABEL DT_PWMS_LABEL(PWM_LED0_NODE)
#define PWM_CHANNEL DT_PWMS_CHANNEL(PWM_LED0_NODE)
#define PWM_FLAGS FLAGS_OR_ZERO(PWM_LED0_NODE)

#define MIN_PERIOD_USEC (USEC_PER_SEC / 64U)

struct device *pwm;
static u32_t period;
static u32_t new_period;

void outputInit()
{
	pwm = device_get_binding(PWM_LABEL);
	if (!pwm) {
		printk("Error: didn't find %s device\n", PWM_LABEL);
		return;
	}

 	period = MIN_PERIOD_USEC;
}

void HandleOutput(tflite::ErrorReporter* error_reporter, int prediction, int label) {
  TF_LITE_REPORT_ERROR(error_reporter, "Model estimates [%d] label [%d]\n", prediction, label);
}
```

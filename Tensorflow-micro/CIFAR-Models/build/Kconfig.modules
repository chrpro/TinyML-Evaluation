## Tensorflow-micro/CIFAR-Models/build/Kconfig.modules
```kconfig
osource "/Users/christosprofentzas/EmbeddedML/ncs/nrf/Kconfig.nrf"

osource "/Users/christosprofentzas/EmbeddedML/ncs/bootloader/mcuboot/zephyr/Kconfig"

osource "/Users/christosprofentzas/EmbeddedML/ncs/nrfxlib/Kconfig.nrfxlib"
```
